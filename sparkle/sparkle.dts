/dts-v1/;
/plugin/;

/ {
	compatible = "ti,beaglebone", "ti,beaglebone-black";
	part-number = "sparkle";
        version = "00A0";

        exclusive-use = "P8.11", "P8.12", "pruss";

	fragment@0 {
		target = <&am33xx_pinmux>;
		__overlay__ {
			sparkle_pins: pinmux_sparkle_pins {
				pinctrl-single,pins = <
					0x034 0x0e /* P8_11 34 OUTPUT MODE6 none */
					0x030 0x0e /* P8_12 30 OUTPUT MODE6 none */
				>;
			};
		};
	};

	fragment@1 {
		target = <&pruss>;
		__overlay__ {
			status = "okay";
			pinctrl-names = "default";
			pinctrl-0 = <&sparkle_pins>;
		};
	};
};
